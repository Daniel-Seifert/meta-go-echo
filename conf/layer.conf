## conf/layer.conf
```bitbake
# We have a conf and classes directory, add to BBPATH
BBPATH .= ":${LAYERDIR}"

# We have recipes-* directories, add to BBFILES
BBFILES += "${LAYERDIR}/recipes-*/*/*.bb \
            ${LAYERDIR}/recipes-*/*/*.bbappend"

BBFILE_COLLECTIONS += "meta-go-echo"
BBFILE_PATTERN_meta-go-echo = "^${LAYERDIR}/"
BBFILE_PRIORITY_meta-go-echo = "6"

LAYERDEPENDS_meta-go-echo = "core"
LAYERSERIES_COMPAT_meta-go-echo = "zeus dunfell"
```
